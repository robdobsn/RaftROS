## Kconfig
```kconfig
menu "RaftROS"

    choice RAFTROS_BACKEND
        prompt "ROS 2 transport backend"
        default RAFTROS_BACKEND_ZENOH
        help
            Which ROS 2 transport this image speaks.  Exactly one backend is
            compiled and linked; there is no runtime switch.  Zenoh is the
            default: it needs a reachable rmw_zenohd router, and costs an order
            of magnitude less main-loop time than RTPS on the same workload.

        config RAFTROS_BACKEND_RTPS
            bool "RTPS / DDS (native ROS 2 over UDP)"
            help
                Talk to ROS 2 directly over RTPS/DDS multicast and unicast UDP,
                as FastDDS and CycloneDDS do.  No router or bridge is needed.

        config RAFTROS_BACKEND_ZENOH
            bool "Zenoh (via an rmw_zenoh router)"
            help
                Talk to ROS 2 through a Zenoh router over one TCP session, as
                rmw_zenoh does.  A router must be reachable; ROS 2 peers must
                also be running rmw_zenoh.

        config RAFTROS_BACKEND_ZENOH_PICO
            bool "Zenoh via zenoh-pico (experimental)"
            help
                The same ROS 2 layer as the Zenoh backend, with the Zenoh
                session provided by Eclipse zenoh-pico instead of Raft's own
                implementation.  For comparing cost and behaviour; Raft's own
                Zenoh backend remains the default.

                zenoh-pico is a third-party library (EPL-2.0 OR Apache-2.0),
                not part of RaftROS and not in this repository.  Fetch the
                pinned version with tools/fetch_zenoh_pico.sh before building.
                It runs its own FreeRTOS task for receiving and lease upkeep,
                and the session is opened from a short-lived helper task
                because zenoh-pico's connect blocks.
    endchoice

    config RAFTROS_ZENOH_PICO_TUNED
        bool "Tune zenoh-pico for RaftROS (experimental)"
        default n
        depends on RAFTROS_BACKEND_ZENOH_PICO
        help
            Smaller zenoh-pico buffers (1 kB batches, 2 kB reassembly, 8
            runtime tasks instead of 64), zenoh-pico's executor task at the
            main loop's priority instead of priority 12, and the session
            open/close helper tasks pinned to CPU0 at low priority.  For
            measuring how much of zenoh-pico's cost is configuration.

    config RAFTROS_ZENOH_ROUTER_HOST
        string "Zenoh router host"
        default ""
        depends on RAFTROS_BACKEND_ZENOH || RAFTROS_BACKEND_ZENOH_PICO
        help
            IPv4 address of the Zenoh router to connect to.  Empty by default:
            the address is configuration, not part of the image.  "routerHost"
            in the SysMod's SysTypes block sets it, and a device is pointed at
            a router (or re-pointed) without a rebuild with
            /api/ros/set?routerHost=<ip>&persist=1, or by posting
            {"RaftROS":{"routerHost":"<ip>"}} to /api/postsettings/reboot.
            An active node with no address waits, saying so once in the log;
            one that cannot reach its router says so, and says where its
            address came from.

            This must be an address, not a hostname: resolving a name blocks
            for as long as the DNS query takes, which would break the Raft
            main-loop budget.

    config RAFTROS_ZENOH_ROUTER_PORT
        int "Zenoh router port"
        default 7447
        range 1 65535
        depends on RAFTROS_BACKEND_ZENOH || RAFTROS_BACKEND_ZENOH_PICO
        help
            TCP port the Zenoh router listens on.  Overridden by the
            "routerPort" setting in the SysMod's SysTypes configuration.

endmenu
```
